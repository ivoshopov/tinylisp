## defconfig
```kconfig
CONFIG_MAIN=y
CONFIG_DO_ELF=y
# CONFIG_DO_LIB=y
# CONFIG_ERROR_SINGLE=y
CONFIG_IO_STD=y
CONFIG_ERROR_PRETTY=y
CONFIG_PRIM_ENV=y
CONFIG_BOXES_STACK=y
#CONFIG_BOXES_ARRAY=y
CONFIG_BOXES_PRINT=y
CONFIG_BOXES_WRITE_TO=y
CONFIG_BOXES_READ_FROM=y
CONFIG_LOOP=y
CONFIG_DEFAULT_PORT="std"
CONFIG_DEFAULT_TRACE_PORT=""
CONFIG_TRACE=y
```
